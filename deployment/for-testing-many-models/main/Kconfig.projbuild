## deployment/for-testing-many-models/main/Kconfig.projbuild
```kconfig
menu "TinyBirdiaryConfig"

    choice MODEL
        prompt "Select the Model you want to use"
        help
            Select this option to choose the Model for the example.

        config MODEL_MBNV2_EQ
            bool "MBNV2 Layerwise EQ"


    endchoice
    choice DATASET
        prompt "Select the Dataset you want to use"
        help
            Select this option to choose the Dataset for the example.

        config DATASET_BIRDIARY
            bool "BIRDIARY"

    endchoice

endmenu
```

## deployment/surface_only/main/libraries/cybergear-robotics__icm20948/Kconfig.projbuild
```kconfig
menu "ICM-20948 Settings"

    config ICM_20948_USE_DMP
        bool "Enable DMP support"
        default false
        help
            Enabling DMP support will include 14 KiBs of proprietary DMP firmware
 
endmenu
```
